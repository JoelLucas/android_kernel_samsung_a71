#include "sm7150-audio.dtsi"
#include "sm7150-battery.dtsi"
#include "sm7150-camera-sensor-common.dtsi"
#include "sm7150-camera-sensor-s2mu106.dtsi"
/*#include "sm7150-camera-sensor-s2mu107.dtsi"*/
#include "sm7150-dcc.dtsi"
#include "sm7150-eif-common.dtsi"
#include "sm7150-eif-s2mu106.dtsi"
/*#include "sm7150-eif-s2mu107.dtsi"*/
#include "sm7150-fingerprint.dtsi"
#include "sm7150-input_booster.dtsi"
#include "sm7150-input-common.dtsi"
#include "sm7150-mst.dtsi"
#include "sm7150-nfc.dtsi"
#include "sm7150-pinctrl-common.dtsi"
#include "sm7150-pm-common.dtsi"
#include "sm7150-reserved-memory.dtsi"
#include "sm7150-sec-a71-display-r04.dtsi"
#include "sm7150-smu106.dtsi"
/*#include "sm7150-smu107.dtsi"*/